## build/board/vf2/visionfive2-uboot-fit-image.its
```
/dts-v1/;

/ {
	description = "Tau FIT image for JH7110 VisionFive2";
	#address-cells = <2>;

	images {
		firmware {
			description = "tau";
			data = /incbin/("../../target/vf2/opensbi/build/platform/generic/firmware/fw_payload.bin");
			type = "firmware";
			arch = "riscv";
			os = "tau";
			load = <0x0 0x40000000>;
			entry = <0x0 0x40000000>;
			compression = "none";
		};
	};

	configurations {
		default = "config-1";

		config-1 {
			description = "Tau FIT config for JH7110 VisionFive2";
			firmware = "firmware";
		};
	};
};
```
